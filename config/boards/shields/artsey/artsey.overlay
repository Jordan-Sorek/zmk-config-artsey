#include <dt-bindings/zmk/matrix_transform.h>

/ {
	chosen {
		zmk,kscan = &kscan0;
		zephyr,display = &oled;
	};

	kscan0: kscan_0 {
		compatible = "zmk,kscan-gpio-direct";

		label = "KSCAN";

		input-gpios
			= <&pro_micro_a 3 (GPIO_ACTIVE_LOW | GPIO_PULL_UP)>
			, <&pro_micro_a 2 (GPIO_ACTIVE_LOW | GPIO_PULL_UP)>
			, <&pro_micro_a 1 (GPIO_ACTIVE_LOW | GPIO_PULL_UP)>
			, <&pro_micro_a 0 (GPIO_ACTIVE_LOW | GPIO_PULL_UP)>
			, <&pro_micro_d 15 (GPIO_ACTIVE_LOW | GPIO_PULL_UP)>
			, <&pro_micro_d 14 (GPIO_ACTIVE_LOW | GPIO_PULL_UP)>
			, <&pro_micro_d 16 (GPIO_ACTIVE_LOW | GPIO_PULL_UP)>
			, <&pro_micro_d 10 (GPIO_ACTIVE_LOW | GPIO_PULL_UP)>
			;

	};
};

&i2c1 {
	status = "okay";
	pinctrl-names = "default";
    pinctrl-0 = <&i2c1_default>;

	oled: ssd1306@3c {
		compatible = "solomon,ssd1306fb-i2c";
		reg = <0x3c>;
		label = "oled";
		width = <128>;
		height = <32>;
		segment-offset = <0>;
		page-offset = <0>;
		
		multiplex-ratio = <31>;
		segment-remap;
		com-invdir;
		com-sequential;
		prechargep1 = <2>;
        prechargep2 = <13>;
		status = "okay";
	};
};

fragment@3 {
    target = <&pinctrl>;
    __overlay__ {
        i2c1_default: i2c1_default {
            group1 {
                psels = <NRF_PSEL(TWIM_SDA, 1, 26)>,   // Adjust pin numbers per your hardware
                        <NRF_PSEL(TWIM_SCL, 1, 27)>;
                bias-pull-up;
            };
        };
    };
}
